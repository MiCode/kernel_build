## kleaf/impl/defconfig/arm64_16k_defconfig
```kconfig
# CONFIG_ARM64_4K_PAGES is not set
CONFIG_ARM64_16K_PAGES=y
CONFIG_PAGE_BLOCK_ORDER=7 # nocheck: See b/424212284
# CONFIG_ARM64_64K_PAGES is not set
CONFIG_LOCALVERSION=""
```
