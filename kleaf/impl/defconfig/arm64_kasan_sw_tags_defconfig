## kleaf/impl/defconfig/arm64_kasan_sw_tags_defconfig
```kconfig
CONFIG_KASAN=y
CONFIG_KASAN_SW_TAGS=y
CONFIG_KASAN_STACK=y
CONFIG_KASAN_OUTLINE=y
# CONFIG_KASAN_HW_TAGS is not set
CONFIG_FRAME_WARN=0
CONFIG_ANDROID_BINDER_IPC_RUST_DUMMY=m
```

## kleaf/impl/defconfig/kasan_generic_defconfig
```kconfig
CONFIG_KASAN=y
CONFIG_KASAN_EXTRA_INFO=y
CONFIG_KCOV=y
CONFIG_KASAN_OUTLINE=y
CONFIG_FRAME_WARN=0
CONFIG_KASAN_GENERIC=y
# CONFIG_KASAN_HW_TAGS is not set
# CONFIG_KASAN_SW_TAGS is not set

# TODO(b/359429865) Remove once our clang has https://github.com/llvm/llvm-project/pull/104826
# CONFIG_CFI_CLANG is not set
```

## kleaf/impl/defconfig/lto_full_defconfig
```kconfig
CONFIG_LTO_CLANG=y
# CONFIG_LTO_NONE is not set
# CONFIG_LTO_CLANG_THIN is not set
CONFIG_LTO_CLANG_FULL=y
# CONFIG_THINLTO is not set # nocheck: Not in upstream
```

## kleaf/impl/defconfig/lto_none_defconfig
```kconfig
# CONFIG_LTO_CLANG is not set
CONFIG_LTO_NONE=y
# CONFIG_LTO_CLANG_THIN is not set
# CONFIG_LTO_CLANG_FULL is not set
# CONFIG_THINLTO is not set # nocheck: Not in upstream
CONFIG_FRAME_WARN=0
```

## kleaf/impl/defconfig/lto_thin_defconfig
```kconfig
CONFIG_LTO_CLANG=y
# CONFIG_LTO_NONE is not set
CONFIG_LTO_CLANG_THIN=y
# CONFIG_LTO_CLANG_FULL is not set
CONFIG_THINLTO=y # nocheck: Not in upstream
```

## kleaf/tests/ddk_config_test/Kconfig.common
```kconfig
menu "Kleaf Testing"

config KLEAF_TEST_COMMON_IMPLICIT_N
	tristate "Kleaf test 1"
	default n
	help
	  A test config.

config KLEAF_TEST_COMMON_EXPLICIT_Y
	tristate "Kleaf test 2"
	default n
	help
	  A test config.

endmenu
```

## kleaf/tests/ddk_config_test/override_defconfig
```kconfig
CONFIG_KLEAF_TEST_COMMON_IMPLICIT_N=y
# CONFIG_KLEAF_TEST_COMMON_EXPLICIT_Y is not set
```

## kleaf/tests/ddk_examples/conditional_defines/kconfig
```kconfig
config DDK_EXAMPLE_FOO_DEBUG
	bool "Enable debug mode for foo"
	help
	  If set, foo is built with debug mode.
```

## kleaf/tests/ddk_examples/conditional_dependency/parent/Kconfig
```kconfig
config DDK_EXAMPLE_PARENT
	tristate "Parent module"
	help
	  If set, build parent module.
```

## kleaf/tests/ddk_menuconfig_test/Kconfig.ddk
```kconfig
menu "Kleaf Testing"

config KLEAF_TEST_1
	tristate "Kleaf test 1"
	default n
	help
	  A test config.

config KLEAF_TEST_2
	tristate "Kleaf test 2"
	default n
	help
	  A test config.

endmenu
```

## kleaf/tests/integration_test/ddk_negative_test/defconfig
```kconfig
CONFIG_DELETED_SET=y
# CONFIG_DELETED_UNSET is not set
CONFIG_DECLARED_SET=y
# CONFIG_DECLARED_UNSET is not set
```
